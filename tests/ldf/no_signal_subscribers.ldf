/*
  Here you will find an odd case that is not normally valid in the LIN specification,
  However is commonly used by OEMs.
  The DummyFrame serves as a "Keep Alive" so slaves don't go to sleep.
*/

LIN_description_file;
LIN_protocol_version = "2.2";
LIN_language_version = "2.2";
LIN_speed = 19.2 kbps;

Nodes {
    Master: master, 5.0 ms, 0.1 ms;
    Slaves: slave1;
}

Signals {
    // Signal with no subscribers
    DummySignal_0: 8, 255, master;
}

Frames {
    DummyFrame: 59, master, 8 {
        DummySignal_0, 0;
    }
}

Node_attributes {
    // Empty
    slave1 {
        LIN_protocol = 2.0;
        configured_NAD = 0x01;
        product_id = 0x4A4F, 0x4841;
    }
}

Schedule_tables {
    RUN_MAIN {
        DummyFrame delay 10.0 ms;
    }
}
